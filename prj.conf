## CMakeLists.txt
```
# Pulls in Zephyr build system
cmake_minimum_required(VERSION 3.13.1)
# include(../zephyr/cmake/app/boilerplate.cmake NO_POLICY_SCOPE)
# include(../nrf/cmake/boilerplate.cmake NO_POLICY_SCOPE)
find_package(Zephyr REQUIRED HINTS ..)
project(node)
zephyr_include_directories(include)

target_sources(app PRIVATE src/main.c)
target_sources(app PRIVATE src/aht20.c)
target_sources(app PRIVATE src/model_handler.c)
```

## west.yml
```
manifest:
  remotes:
    - name: ncs
      url-base: https://github.com/nrfconnect
  projects:
    - name: nrf
      repo-path: sdk-nrf
      remote: ncs
      revision: v1.7.0
      import: true
  self:
    path: application
```

## prj.conf
```kconfig
CONFIG_NCS_SAMPLES_DEFAULTS=y
CONFIG_DK_LIBRARY=y
CONFIG_HWINFO=y

CONFIG_STDOUT_CONSOLE=y
CONFIG_PRINTK=y

CONFIG_I2C=y

# Bluetooth configuration
CONFIG_BT=y
CONFIG_BT_COMPANY_ID=0x0059
CONFIG_BT_DEVICE_NAME="Enviro Sensor"
CONFIG_BT_L2CAP_TX_MTU=69
CONFIG_BT_L2CAP_TX_BUF_COUNT=8
CONFIG_BT_OBSERVER=y
CONFIG_BT_PERIPHERAL=y
CONFIG_BT_SETTINGS=y

# Disable unused Bluetooth features
CONFIG_BT_CTLR_DUP_FILTER_LEN=0
CONFIG_BT_CTLR_LE_ENC=n
CONFIG_BT_DATA_LEN_UPDATE=n
CONFIG_BT_PHY_UPDATE=n
CONFIG_BT_CTLR_CHAN_SEL_2=n
CONFIG_BT_CTLR_MIN_USED_CHAN=n
CONFIG_BT_CTLR_PRIVACY=n

# Bluetooth mesh configuration
CONFIG_BT_MESH=y
CONFIG_BT_MESH_RELAY=y
CONFIG_BT_MESH_FRIEND=y
CONFIG_BT_MESH_ADV_BUF_COUNT=13
CONFIG_BT_MESH_TX_SEG_MAX=10
CONFIG_BT_MESH_PB_GATT=y
CONFIG_BT_MESH_GATT_PROXY=y
CONFIG_BT_MESH_DK_PROV=y

CONFIG_BT_DEBUG_LOG=y

# Bluetooth mesh models
CONFIG_BT_MESH_SENSOR_SRV=y

# Non volatile Storage
CONFIG_FLASH=y
CONFIG_FLASH_PAGE_LAYOUT=y
CONFIG_FLASH_MAP=y
CONFIG_NVS=y
CONFIG_SETTINGS=y

# use Zephyr's BTLE controller, recommended http://developer.nordicsemi.com/nRF_Connect_SDK_dev/doc/PR-4304/nrf/ug_bt_mesh_configuring.html
CONFIG_BT_LL_SW_SPLIT=y
```

## boards/particle_xenon.overlay
```dts
&i2c0 {
	/*
	 * This i2c node can be TWI, TWIM, or TWIS,
	 * for the user to pick:
	 * compatible = "nordic,nrf-twi" or
	 *              "nordic,nrf-twim" or
	 *              "nordic,nrf-twis".
	 */
	compatible = "nordic,nrf-twim";
	clock-frequency = <I2C_BITRATE_STANDARD>;
	interrupts = <3 NRF_DEFAULT_IRQ_PRIORITY>;
	status = "okay";
	label = "I2C_0";
	sda-pin = <26>;
	scl-pin = <27>;
};
```

## src/main.c
```c
#include "model_handler.h"
#include <bluetooth/bluetooth.h>
#include <bluetooth/mesh/dk_prov.h> // investigate
#include <bluetooth/mesh/models.h>
#include <device.h>
#include <dk_buttons_and_leds.h>
#include <drivers/hwinfo.h>
#include <drivers/i2c.h>
#include <errno.h>
#include <settings/settings.h>
#include <sys/printk.h> //Kernel printing
#include <zephyr.h>

// static int no_outputnum(bt_mesh_output_action_t action, uint32_t number) {
//   return -ENOTSUP;
// }
// static int no_outputstr(const char *string) {
//   return -ENOTSUP;
// }
//
// static uint8_t dev_uuid[16];
//
// static const struct bt_mesh_prov prov = {
//   .uuid = dev_uuid,
//   .output_actions = BT_MESH_BLINK,
//   .output_number = output_number

// const struct bt_mesh_prov *provision_init(void) {
//  hwinfo_get_device_id(dev_uuid, sizeof(dev_uuid));
//
// Liberated from NCS samples/bluetooth/mesh/sensor_server
static void bt_ready(int err) {
  if (err) {
    printk("Bluetooth init failed (err %d)\n", err);
    return;
  }

  printk("Bluetooth initialized\n");

  // intializes dev board leds & buttons
  dk_leds_init();
  dk_buttons_init(NULL);

  printk("Initializing...");

  err = bt_mesh_init(bt_mesh_dk_prov_init(), model_handler_init());
  if (err) {
    printk("Initializing mesh failed (err %d)\n", err);
    return;
  }

  if (IS_ENABLED(CONFIG_SETTINGS)) {
    settings_load();
  }

  /* This will be a no-op if settings_load() loaded provisioning info */
  bt_mesh_prov_enable(BT_MESH_PROV_ADV | BT_MESH_PROV_GATT);

  printk("Mesh initialized\n");
}

void main(void) {
  int err = bt_enable(bt_ready);
  if (err) {
    printk("BT init failed at bt_enable. (err %d)\n", err);
  }
}
```

## include/aht20.h
```c
/// This module presents a high level interface to the AHT20 sensor.
///
/// To use the sensor first call the aht_init method to initialize
/// and calibrate the device. After calibration there are two methods to
/// reading the sensor, blocking and asynchronously.
///
/// To do a blocking measurement, issue the aht_blocking_measure command. This
/// command will have the sensor take a measurement, wait for approximately
/// 80ms while the sensor measures and prepares the data, read the data from
/// the sensor, and return the sensor data.
///
/// To do an asynchronous measurement...
/// This functionality is not yet implemented.
///
/// TODO: provide a wrapper that provides callbacks to a statemachine that
/// handles the aht_async_measure, aht_is_busy, and aht_async_read functions.
/// The methodology is to start a measurement by calling the aht_async_measure
/// command. The measurement takes approximately 80 milliseconds. The status of
/// the measurement is checked by calling the aht_is_busy command. Finally,
/// once the measurement is ready, the data can be read by calling the
/// aht_async_read command. The end state of this should be to update a global
/// sensor state variable that is shared between the IRQ callbacks and the main
/// code thread.
#ifndef _AHT20
#define _AHT20

#include <device.h>

enum aht_error { AHT_NO_ERROR = 0, AHT_BAD_CRC, AHT_NO_RESPONSE };

struct aht_status {
  bool busy;
  bool calibrated;
};

struct aht_data {
  struct aht_status status;
  int16_t temperature; // 0.01C
  uint16_t humidity;   // 0.01% Relative Humidity
  uint8_t crc;
};

/// Initialize sensor
enum aht_error aht_init(const struct device *i2c_dev);

/// Check if measurement in progress
bool aht_is_busy(const struct device *i2c_dev);

enum aht_error aht_blocking_measure(const struct device *i2c_dev,
                                    struct aht_data *data);

// enum aht_error aht_async_measure(const struct device *i2c_dev);
//
// /// Read the result of the measurement
// ///
// /// Caller must verify the status field of aht_data. If busy is set then
// /// values are stale
// enum aht_error aht_async_read(const struct device *i2c_dev,
//                              struct aht_data *data);
#endif
```

## include/model_handler.h
```c
/// handles models?

#ifndef _MODEL_HANDLER
#define _MODEL_HANDLER

#include <bluetooth/mesh.h>

#ifdef __cplusplus
extern "C" {
#endif

const struct bt_mesh_comp *model_handler_init(void);

#ifdef __cplusplus
}
#endif

#endif
```

## src/aht20.c
```c
#include "aht20.h"
#include <device.h>
#include <drivers/i2c.h>
#include <sys/crc.h>
#include <zephyr.h>

// Module internal-only stuff

#define AHT_ADDR 0x38

// polynomial is x8 + x5 + x4 + 1 = 0b0011_0001
#define AHT_CRC_POLY 0x31

// IV is 0xff
#define AHT_CRC_IV 0xff

/// Reset the AHT20 Sensor
static void reset(const struct device *i2c_dev) {
  uint8_t reset_msg[1] = {0xBA};
  if (i2c_write(i2c_dev, reset_msg, 1, AHT_ADDR)) {
    printk("Error Sending AHT Reset command\n");
  }
}

/// Calibrate the AHT20 Sensor
static void calibrate(const struct device *i2c_dev) {
  uint8_t msg[3] = {0xbe, 0x08, 0};
  if (i2c_write(i2c_dev, msg, 3, AHT_ADDR)) {
    printk("Error Sending AHT Calibrate command\n");
  }
}

/// Return the current AHT Status
static void translate_status(uint8_t status_byte, struct aht_status *status) {
  status->busy = status_byte & (1 << 7);
  status->calibrated = status_byte & (1 << 3);
}

// External facing methods

/// Initialize sensor
enum aht_error aht_init(const struct device *i2c_dev) {
  // Wait 100ms after powering, per AHT20 datasheet
  k_msleep(100);

  reset(i2c_dev);
  calibrate(i2c_dev);
  return AHT_NO_ERROR;
}

/// Check if measurement in progress
bool aht_is_busy(const struct device *i2c_dev) {
  uint8_t data[1];
  int ret;
  struct aht_status status;

  ret = i2c_read(i2c_dev, data, 1, AHT_ADDR);

  if (ret != 0) {
    printk("I2C: AHT20: Error reading status in aht_is_busy. Error (%d)\n",
           ret);
    return true; // try again
  }

  translate_status(data[0], &status);
  return status.busy;
}

enum aht_error aht_blocking_measure(const struct device *i2c_dev,
                                    struct aht_data *data) {
  uint8_t start_msg[3] = {0xAC, 0x33, 0x00};
  uint8_t data_msg[7];
  uint32_t raw_temp, raw_humidity;
  int retval;

  // Start measurement
  retval = i2c_write(i2c_dev, start_msg, 3, AHT_ADDR);
  if (retval != 0) {
    printk("I2C: Error sending AHT20 start command. code (%d)\n", retval);
    return AHT_NO_RESPONSE;
  }

  // AHT20 takes at least 80ms to measure, per datasheet.
  // It's nice to share.
  k_msleep(80);

  // Time's up, data should be ready. Poll device until it's ready.
  // Assume device is busy.
  data->status.busy = true;
  while (data->status.busy) {
    i2c_read(i2c_dev, data_msg, 7, AHT_ADDR);
    translate_status(data_msg[0], &(data->status));
  }

  // got new data, check crc.
  // per AHT20 datasheet
  uint8_t crc = crc8(data_msg, 6, AHT_CRC_POLY, AHT_CRC_IV, false);
  if (crc != data_msg[6]) {
    printk("AHT: CRC Error, got %d, expected %d\n", data_msg[6], crc);
    return AHT_BAD_CRC;
  }
  data->crc = data_msg[6];

  // Temperature Conversion, aht_data units are 0.01degC, -50C -> 150C
  // counts * 200 / (2**20) = 0.000190734863281 counts / degC
  // = 5242.88degC/count = counts * 100 / 524288degC
  // = counts * 100 * 100 / 524288 (0.01degC)
  // = counts * (2000 / 8) * 5 / 65536 (0.01degC) << minimal loss, no div
  //
  // measurement offset 50C => 5000 (0.01degC)
  // TODO: Learn to trust the FPU.
  raw_temp = data_msg[5] + (data_msg[4] << 8) + ((data_msg[3] & 0xF) << 16);
  raw_temp *= 2000;         // at 2**20-1, uses most of 32bits
  raw_temp = raw_temp >> 3; // divide by 8
  raw_temp *= 5;
  raw_temp = raw_temp >> 16;
  raw_temp -= 5000;
  data->temperature = (int16_t)raw_temp;

  // Humidity Conversion, aht_data units are 0.01%rh, 0-100%
  // counts * 100 / (2**20) => 10485.76 percent/count
  // counts * 10000 / 1048576 = counts * 5000 / 524288
  // can use same methodology as above
  raw_humidity = (data_msg[3] + (data_msg[2] << 8) + (data_msg[1] << 16)) >> 4;
  raw_humidity *= 1000;
  raw_humidity = raw_humidity >> 3;
  raw_humidity *= 5;
  raw_humidity = raw_humidity >> 16;
  data->humidity = (uint16_t)raw_humidity;

  return AHT_NO_ERROR;
}

enum aht_error aht_async_measure(const struct device *i2c_dev) {
  printk("aht_async_measure is not implemented!\n");
  return AHT_NO_RESPONSE;
}

/// Read the result of the measurement
///
/// Caller must verify the status field of aht_data. If busy is set then
/// values are stale
enum aht_error aht_async_read(const struct device *i2c_dev,
                              struct aht_data *data) {
  printk("aht_async_read is not implemented!\n");
  return AHT_NO_RESPONSE;
}
```

## src/model_handler.c
```c
#include "model_handler.h"
#include "aht20.h"
#include "bluetooth/mesh/access.h"
#include <bluetooth/bluetooth.h>
#include <bluetooth/mesh/models.h>
#include <dk_buttons_and_leds.h>

// local "globals"
static const struct device *i2c0_dev; // stores sensor bus
static struct aht_data data;          // stores sensor values
static struct sensor_value temp_val = {0};
static struct sensor_value humid_val = {0};

// Sensor Server
// =============

// getter to read latest Temp values into mesh model
// TODO: Convert AHT20 to sensor?
static int temp_get(struct bt_mesh_sensor *sensor, struct bt_mesh_msg_ctx *ctx,
                    struct sensor_value *rsp) {
  // load sensor data into model value
  rsp->val1 = temp_val.val1;
  rsp->val2 = temp_val.val2;
  return 0;
}

static struct bt_mesh_sensor_descriptor temp_desc = {
    .tolerance = // Sensor Tolerance
    {
        .positive = {0, 500000}, // + 0.5°C
        .negative = {0, 500000}, // - 0.5°C
    },
    .sampling_type = BT_MESH_SENSOR_SAMPLING_INSTANTANEOUS, // One value
    .period = 0,          // One value, no period.
    .update_interval = 0, // One value, no update interval
};

// Temperature Sensor Model
static struct bt_mesh_sensor amb_temp = {
    .type = &bt_mesh_sensor_precise_present_amb_temp, // Property ID
    .get = temp_get,                                  // Value getter
    .descriptor = &temp_desc,                         // Sensor Descriptor
};

// Callback to read latest Humidity values into mesh model
static int humid_get(struct bt_mesh_sensor *sensor, struct bt_mesh_msg_ctx *ctx,
                     struct sensor_value *rsp) {
  // load sensor data into model value
  rsp->val1 = humid_val.val1;
  rsp->val2 = humid_val.val2;
  return 0;
}

static struct bt_mesh_sensor_descriptor humid_desc = {
    .tolerance = // Sensor Tolerance
    {
        .positive = {3, 0}, // + 3%
        .negative = {3, 0}, // - 3%
    },
    .sampling_type = BT_MESH_SENSOR_SAMPLING_INSTANTANEOUS, // One value
    .period = 0,          // One value, no period.
    .update_interval = 0, // One value, no update interval
};

// Humidity Sensor Model
static struct bt_mesh_sensor amb_humidity = {
    .type = &bt_mesh_sensor_present_amb_rel_humidity, // Property ID
    .get = humid_get,                                 // Value getter
    .descriptor = &humid_desc,                        // Sensor Descriptor
};

// Sensor Server Model
static struct bt_mesh_sensor *const sensors[] = {
    &amb_temp,
    &amb_humidity,
};

static struct bt_mesh_sensor_srv sensor_srv =
    BT_MESH_SENSOR_SRV_INIT(sensors, ARRAY_SIZE(sensors));

// Health Server
// =============

// Zephyr Job handle for blinking lights when need to draw attention
static struct k_work_delayable attention_blink_work;

// Attention state variable
static bool attention;

// Zephyr job to draw attention
// TODO: Should we reschedule attention_blink_work or work that's passed in?
static void attention_blink(struct k_work *work) {
  if (attention) {
    dk_set_leds(BIT(1) | BIT(2));
    k_work_reschedule(&attention_blink_work, K_MSEC(100));
  } else {
    dk_set_leds(DK_NO_LEDS_MSK);
  }
}

// set attention, schedule work
static void attention_on(struct bt_mesh_model *mod) {
  attention = true;
  k_work_reschedule(&attention_blink_work, K_NO_WAIT);
}

// clear attention
static void attention_off(struct bt_mesh_model *mod) {
  attention = false;
  // no reschedule
}

// Health Server Callback datastructure
static const struct bt_mesh_health_srv_cb health_srv_cb = {
    .attn_on = attention_on,
    .attn_off = attention_off,
};

// Health Server
static struct bt_mesh_health_srv health_srv = {
    .cb = &health_srv_cb,
};

BT_MESH_HEALTH_PUB_DEFINE(health_pub, 0);

static struct bt_mesh_elem elements[] = {
    BT_MESH_ELEM(
        1,
        BT_MESH_MODEL_LIST(BT_MESH_MODEL_CFG_SRV,
                           BT_MESH_MODEL_HEALTH_SRV(&health_srv, &health_pub),
                           BT_MESH_MODEL_SENSOR_SRV(&sensor_srv)),
        BT_MESH_MODEL_NONE),
};

static const struct bt_mesh_comp comp = {
    .cid = CONFIG_BT_COMPANY_ID,
    .elem = elements,
    .elem_count = ARRAY_SIZE(elements),
};

static struct k_work_delayable ambient_sensor_work;

static struct bt_mesh_msg_ctx pub_ctx = {.net_idx = 0,
                                         .app_idx = 0,
                                         .addr = 0xFFFF, // broadcast publish
                                         .send_ttl = BT_MESH_TTL_DEFAULT};

static void ambient_sensor_get(struct k_work *work) {
  // get fresh value from sensor
  enum aht_error aht_err = aht_blocking_measure(i2c0_dev, &data);
  if (aht_err != AHT_NO_ERROR) {
    printk("Error while performing AHT20 measure! (err %d)", aht_err);
  } else {
    printk("New sensor data! Temp: %d, Humid: %d, cal: %d, busy: %d\n",
           data.temperature, data.humidity, data.status.calibrated,
           data.status.busy);
    temp_val.val1 = data.temperature / 100;
    temp_val.val2 = (data.temperature % 100) * 10000;
    humid_val.val1 = data.humidity / 100;
    humid_val.val2 = (data.humidity % 100) * 10000;
  }

  // forced publication. Desired?
  printk("Publishing Temp. retval %d\n",
         bt_mesh_sensor_srv_pub(&sensor_srv, &pub_ctx, &amb_temp, &temp_val));
  // bt_mesh_sensor_srv_sample(&sensor_srv, &amb_temp));
  // printk("slept for %d\n", 10000 - k_msleep(10000));
  printk(
      "Publishing Humdity. reval %d\n",
      bt_mesh_sensor_srv_pub(&sensor_srv, &pub_ctx, &amb_humidity, &humid_val));
  // bt_mesh_sensor_srv_sample(&sensor_srv, &amb_humidity));

  k_work_reschedule(&ambient_sensor_work, K_MSEC(30 * 1000));
}

/// Initialize the BT Mesh node.
/// @returns node composition to pass into bt_mesh_init in main
const struct bt_mesh_comp *model_handler_init(void) {
  printk("handler called\n");
  i2c0_dev = device_get_binding("I2C_0");
  if (!i2c0_dev) {
    printk("Unable to get I2C bus!\n");
  }
  enum aht_error aht_err = aht_init(i2c0_dev);
  if (aht_err != AHT_NO_ERROR) {
    printk("Error Initializing AHT20! (err %d)\n", aht_err);
  }

  k_work_init_delayable(&attention_blink_work, attention_blink);
  k_work_init_delayable(&ambient_sensor_work, ambient_sensor_get);
  k_work_reschedule(&ambient_sensor_work, K_NO_WAIT);
  return &comp;
}
```
